## boot/barebox/barebox-2/Config.in
```kconfig
menuconfig BR2_TARGET_BAREBOX_2
	bool "Build barebox with a 2nd config"
	help
	  Build barebox with a 2nd configuration.

	  Useful for building an SPL (Secondary Program Loader) in addition to
	  the traditional TPL (Tertiary Program Loader), such as the X-Loader
	  or MLO for Texas Instruments processors.

if BR2_TARGET_BAREBOX_2

choice
	prompt "Barebox configuration"
	default BR2_TARGET_BAREBOX_2_USE_DEFCONFIG

config BR2_TARGET_BAREBOX_2_USE_DEFCONFIG
	bool "Using a defconfig"

config BR2_TARGET_BAREBOX_2_USE_CUSTOM_CONFIG
	bool "Using a custom config file"

endchoice

config BR2_TARGET_BAREBOX_2_BOARD_DEFCONFIG
	string "board defconfig"
	depends on BR2_TARGET_BAREBOX_2_USE_DEFCONFIG
	help
	  Name of the board for which Barebox should be built, without
	  the _defconfig suffix.


config BR2_TARGET_BAREBOX_2_CUSTOM_CONFIG_FILE
	string "Configuration file path"
	depends on BR2_TARGET_BAREBOX_2_USE_CUSTOM_CONFIG
	help
	  Path to the barebox configuration file

config BR2_TARGET_BAREBOX_2_CONFIG_FRAGMENT_FILES
	string "Additional configuration fragment files"
	help
	  A space-separated list of configuration fragment files,
	  that will be merged to the main Barebox configuration file.

config BR2_TARGET_BAREBOX_2_BUILT_IMAGE_FILE
	string "Built image filename"
	default "barebox-flash-image"
	help
	  Name of the built barebox image filename in the barebox build or
	  build images directory.

	  Set to barebox.bin for barebox versions older than 2012.10.

config BR2_TARGET_BAREBOX_2_OUTPUT_IMAGE_FILE
	string "Output image filename"
	default "barebox-2.bin"
	help
	  Name to use when copying the barebox image to the output/images
	  directory.

config BR2_TARGET_BAREBOX_2_CUSTOM_ENV
	bool "Generate an environment image"
	help
	  Generate a custom environment image. This environment will
	  contain the variables and scripts to be used at boot by
	  barebox.

config BR2_TARGET_BAREBOX_2_CUSTOM_ENV_PATH
	string "Environment path"
	depends on BR2_TARGET_BAREBOX_2_CUSTOM_ENV
	help
	  Path to the directory containing the custom barebox
	  environment. Depending on your setup, it will probably be
	  based on either the content of the defaultenv or
	  defaultenv-2 directories in the barebox source code, plus
	  the additions needed. The output will be an image in the
	  barebox devfs format, stored in the images directory, with
	  the same name as the directory name given here.

endif
```

## configs/beaglebone_barebox_defconfig
```kconfig
# architecture
BR2_arm=y
BR2_cortex_a8=y
BR2_ARM_EABIHF=y

# system
BR2_TARGET_GENERIC_HOSTNAME="beaglebone"
BR2_ROOTFS_DEVICE_CREATION_DYNAMIC_DEVTMPFS=y
BR2_TARGET_GENERIC_REMOUNT_ROOTFS_RW=y

# filesystem
BR2_PACKAGE_AM33X_CM3=y
BR2_TARGET_ROOTFS_EXT2=y
BR2_TARGET_ROOTFS_EXT2_4=y
# BR2_TARGET_ROOTFS_TAR is not set

# Linux headers same as kernel, a 4.5 series
BR2_PACKAGE_HOST_LINUX_HEADERS_CUSTOM_4_5=y

# bootloader
BR2_TARGET_BAREBOX=y
BR2_TARGET_BAREBOX_BOARD_DEFCONFIG="am335x"
BR2_TARGET_BAREBOX_IMAGE_FILE="images/barebox-am33xx-beaglebone.img"
BR2_TARGET_BAREBOX_CUSTOM_ENV=y
BR2_TARGET_BAREBOX_CUSTOM_ENV_PATH="board/beaglebone/barebox/barebox.env"
BR2_TARGET_BAREBOX_2=y
BR2_TARGET_BAREBOX_2_BOARD_DEFCONFIG="am335x_mlo"
BR2_TARGET_BAREBOX_2_IMAGE_FILE="images/barebox-am33xx-beaglebone-mlo.img"

# use board/beaglebone/genimage.cfg to generate boot.vfat and sdcard.img
BR2_ROOTFS_POST_IMAGE_SCRIPT="board/beaglebone/barebox/post-image.sh"
BR2_PACKAGE_HOST_GENIMAGE=y

# kernel
BR2_LINUX_KERNEL=y
BR2_LINUX_KERNEL_CUSTOM_VERSION=y
BR2_LINUX_KERNEL_CUSTOM_VERSION_VALUE="4.5.2"
BR2_LINUX_KERNEL_USE_DEFCONFIG=y
BR2_LINUX_KERNEL_DEFCONFIG="omap2plus"
BR2_LINUX_KERNEL_ZIMAGE=y

# use the barebox built-in dtb
# BR2_LINUX_KERNEL_DTS_SUPPORT is not set
```
